## module/dts/bindings/motor/hpmicro,tb6612-chassis.yaml
```yaml
# Copyright (c) 2026 Cody Gu <gujiaqi@iscas.ac.cn>
# SPDX-License-Identifier: Apache-2.0

description: Differential chassis with two TB6612FNG channels.

compatible: "hpmicro,tb6612-chassis"

include: [base.yaml, pinctrl-device.yaml]

properties:
  pwms:
    type: phandle-array
    required: true
    description: Left and right PWM outputs, in that order.

  left-in1-gpios:
    type: phandle-array
    required: true

  left-in2-gpios:
    type: phandle-array
    required: true

  right-in1-gpios:
    type: phandle-array
    required: true

  right-in2-gpios:
    type: phandle-array
    required: true

  right-invert:
    type: boolean
    description: Reverse the right motor direction in software.

  standby-gpios:
    type: phandle-array
    required: true

  pinctrl-0:
    required: true

  pinctrl-names:
    required: true
```

## tests/hid_report/testcase.yaml
```yaml
# SPDX-License-Identifier: Apache-2.0

tests:
  app.miraczv.hid_report:
    platform_allow: native_sim
    integration_platforms:
      - native_sim
    tags: hid
```
